## conf/bblayers.conf.sample
```bitbake
# SPDX-FileCopyrightText: Huawei Inc.
#
# SPDX-License-Identifier: Apache-2.0

# POKY_BBLAYERS_CONF_VERSION is increased each time build/conf/bblayers.conf
# changes incompatibly
POKY_BBLAYERS_CONF_VERSION = "2"

BBPATH = "${TOPDIR}"
BBFILES ?= ""

BBLAYERS ?= " \
  ##OEROOT##/../oniro/meta-oniro-staging \
  ##OEROOT##/meta \
  ##OEROOT##/../meta-clang \
  ##OEROOT##/../meta-openembedded/meta-oe \
  ##OEROOT##/../meta-openembedded/meta-python \
  ##OEROOT##/../meta-openharmony \
  ##OEROOT##/../meta-java \
  "
```

## conf/distro/include/musl-ldso-paths.inc
```bitbake
# SPDX-FileCopyrightText: Huawei Inc.
#
# SPDX-License-Identifier: Apache-2.0

MUSL_LDSO_PATHS = " \
	module \
	module/ability \
	module/account \
	module/app \
	module/data \
	module/distributedhardware \
	module/multimedia \
	module/telephony \
"

MUSL_LDSO_PATHS:append:openharmony-3.1 = " \
	module/application \
	module/bundle \
	module/events \
	module/multimodalinput \
	module/net \
	module/security \
"
```

## conf/distro/include/openharmony.inc
```bitbake
# SPDX-FileCopyrightText: Huawei Inc.
#
# SPDX-License-Identifier: Apache-2.0

# OpenHarmony OS version
OPENHARMONY_VERSION ?= "3.1"
OPENHARMONY_VERSION_FULL = "${OPENHARMONY_VERSION}"
OPENHARMONY_VERSION_FULL:openharmony-3.0 = "3.0.1"
OPENHARMONY_VERSION_FULL:openharmony-3.1 = "3.1.1"

# Generic and version specific OpenHarmony DISTROOVERRIDES
# Enabling "openharmony" distro feature activates the "df-openharmony"
# override, which can therefore be used for overriding stuff independent of
# OpenHarmony version.
# For overriding for a specific OpenHarmony version, use e.g. "openharmony-3.0"
# OpenHarmony 3.0 specific override, And similar for other supported versions.
INHERIT += "distrooverrides"
DISTRO_FEATURES_OVERRIDES += "openharmony"
OPENHARMONY_OVERRIDES = ""
OPENHARMONY_OVERRIDES:df-openharmony = ":openharmony-${OPENHARMONY_VERSION}"
DISTROOVERRIDES:append = "${OPENHARMONY_OVERRIDES}"

PREFERRED_VERSION_openharmony-standard = "${OPENHARMONY_VERSION}"
```

## conf/distro/include/openssl.inc
```bitbake
# SPDX-FileCopyrightText: Huawei Inc.
#
# SPDX-License-Identifier: Apache-2.0

# Configuration of OpenSSL recipe

# Disable various ciphers and protocols
PACKAGECONFIG:pn-openssl:df-openharmony = "no-bf no-camellia no-cast no-ct no-md2 no-rc5 no-rc2 no-ripemd no-rmd160 no-ssl2 no-ssl3 no-ssl3-method"

# Arm 32-bit configuration
CFLAGS:pn-openssl:df-openharmony:append:arm = " -DOPENSSL_CPUID_OBJ"
CFLAGS:pn-openssl:df-openharmony:append:arm = " -DOPENSSL_BN_ASM_MONT"
CFLAGS:pn-openssl:df-openharmony:append:arm = " -DOPENSSL_BN_ASM_GF2m"
CFLAGS:pn-openssl:df-openharmony:append:arm = " -DSHA1_ASM"
CFLAGS:pn-openssl:df-openharmony:append:arm = " -DSHA256_ASM"
CFLAGS:pn-openssl:df-openharmony:append:arm = " -DSHA512_ASM"
CFLAGS:pn-openssl:df-openharmony:append:arm = " -DKECCAK1600_ASM"
CFLAGS:pn-openssl:df-openharmony:append:arm = " -DAES_ASM"
CFLAGS:pn-openssl:df-openharmony:append:arm = " -DBSAES_ASM"
CFLAGS:pn-openssl:df-openharmony:append:arm = " -DGHASH_ASM"
CFLAGS:pn-openssl:df-openharmony:append:arm = " -DECP_NISTZ256_ASM"
CFLAGS:pn-openssl:df-openharmony:append:arm = " -DPOLY1305_ASM"

# Arm 64-bit configuration
CFLAGS:pn-openssl:df-openharmony:append:aarch64 = " -DOPENSSL_CPUID_OBJ"
CFLAGS:pn-openssl:df-openharmony:append:aarch64 = " -DOPENSSL_BN_ASM_MONT"
CFLAGS:pn-openssl:df-openharmony:append:aarch64 = " -DSHA1_ASM"
CFLAGS:pn-openssl:df-openharmony:append:aarch64 = " -DSHA256_ASM"
CFLAGS:pn-openssl:df-openharmony:append:aarch64 = " -DSHA512_ASM"
CFLAGS:pn-openssl:df-openharmony:append:aarch64 = " -DKECCAK1600_ASM"
CFLAGS:pn-openssl:df-openharmony:append:aarch64 = " -DVPAES_ASM"
CFLAGS:pn-openssl:df-openharmony:append:aarch64 = " -DECP_NISTZ256_ASM"
CFLAGS:pn-openssl:df-openharmony:append:aarch64 = " -DPOLY1305_ASM"
```

## conf/distro/oniro-openharmony-linux.conf
```bitbake
# SPDX-FileCopyrightText: Huawei Inc.
#
# SPDX-License-Identifier: Apache-2.0

DISTRO = "oniro-openharmony-linux"
DISTRO_NAME = "Oniro/OpenHarmony Linux Distro"
DISTRO_VERSION = "1.99.99"

# OpenHarmony OS version
require include/openharmony.inc
DISTRO_FEATURES:append = " openharmony"

# LLVM/Clang toolchain
TOOLCHAIN = "clang"
RUNTIME = "llvm"

# musl libc
TCLIBC = "musl"

# Include clang in generated SDK toolchain
CLANGSDK = "1"
# Include static libraries in SDK
SDKIMAGE_FEATURES:append = " staticdev-pkgs"

ONIRO_OPENHARMONY_DEFAULT_DISTRO_FEATURES = "ipv4 ptest"
DISTRO_FEATURES ?= "${ONIRO_OPENHARMONY_DEFAULT_DISTRO_FEATURES}"

# Linux kernel version
PREFERRED_VERSION_linux-yocto = "5.10.%"
PREFERRED_VERSION_linux-raspberrypi = "5.10.%"
PREFERRED_PROVIDER_virtual/kernel = "linux-openharmony"

# Attempt to isolate the buidl system from the host distribution's C library
require conf/distro/include/yocto-uninative.inc
INHERIT += "uninative"

# Workaround for missing host tools in do_testimage when not adding testimage to
# IMAGE_CLASSES, but doing a direct `inherit testimage` in image recipes
# instead.
HOSTTOOLS += "ip ping ps scp ssh stty"

# Yocto does not have ssh-keygen-native, so we need to use ssh-keygen from host
HOSTTOOLS += "ssh-keygen"

# Add truncate host tool which is used by ohos mkimage scripts
HOSTTOOLS += "truncate"

# Default to enabling serial debug console on RaspberryPi
# Placed here to amend the machine config living in meta-raspberrypi
ENABLE_UART:raspberrypi4-64 ?= "1"

DISTRO_FEATURES += "wifi"

# Allow running the system without hdmi display connected
DISABLE_VC4GRAPHICS:raspberrypi4-64 = "1"
RPI_EXTRA_CONFIG:raspberrypi4-64 = ' \n \
    dtoverlay=vc4-fkms-v3d \n \
    '
HDMI_FORCE_HOTPLUG:raspberrypi4-64 = "1"
```

## conf/layer.conf
```bitbake
# SPDX-FileCopyrightText: Huawei Inc.
#
# SPDX-License-Identifier: Apache-2.0

# We have a conf directory, add to BBPATH
BBPATH .= ":${LAYERDIR}"

# We have recipes-* directories, add to BBFILES
BBFILES += "${LAYERDIR}/recipes-*/*/*.bb \
            ${LAYERDIR}/recipes-*/*/*.bbappend"

BBFILE_COLLECTIONS += "meta-openharmony"
BBFILE_PATTERN_meta-openharmony = "^${LAYERDIR}/"
BBFILE_PRIORITY_meta-openharmony = "5"

LAYERDEPENDS_meta-openharmony = "core"
LAYERDEPENDS_meta-openharmony += "openembedded-layer"
LAYERDEPENDS_meta-openharmony += "oniro-staging"
LAYERDEPENDS_meta-openharmony += "meta-python"
LAYERDEPENDS_meta-openharmony += "clang-layer"

LAYERSERIES_COMPAT_meta-openharmony = "kirkstone"
```

## conf/local.conf.sample
```bitbake
# SPDX-FileCopyrightText: Huawei Inc.
#
# SPDX-License-Identifier: Apache-2.0

#
# This file is your local configuration file and is where all local user settings
# are placed. The comments in this file give some guide to the options a new user
# to the system might want to change but pretty much any configuration option can
# be set in this file. More adventurous users can look at local.conf.extended
# which contains other examples of configuration which can be placed in this file
# but new users likely won't need any of them initially.
#
# Lines starting with the '#' character are commented out and in some cases the
# default values are provided as comments to show people example syntax. Enabling
# the option is a question of removing the # character and making any change to the
# variable as required.


# Machine Selection
#
# You need to select a specific machine to target the build with. There are a selection
# of emulated machines available which can boot and run in the QEMU emulator:
#
#MACHINE ?= "qemuarma7"
#
# This sets the default machine to qemuarma7 if no other machine is selected:
MACHINE ??= "qemuarma7"

#
# SDK target architecture
#
# This variable specifies the architecture to build SDK items for and means
# you can build the SDK packages for architectures other than the machine you are
# running the build on (i.e. building i686 packages on an x86_64 host).
# Supported values are i686 and x86_64
#SDKMACHINE ?= "i686"

#
# Default policy config
#
DISTRO ?= "oniro-openharmony-linux"

#
# Extra image configuration defaults
#
# The EXTRA_IMAGE_FEATURES variable allows extra packages to be added to the generated
# images. Some of these options are added to certain image types automatically. The
# variable can contain the following options:
#  "dbg-pkgs"       - add -dbg packages for all installed packages
#                     (adds symbol information for debugging/profiling)
#  "src-pkgs"       - add -src packages for all installed packages
#                     (adds source code for debugging)
#  "dev-pkgs"       - add -dev packages for all installed packages
#                     (useful if you want to develop against libs in the image)
#  "ptest-pkgs"     - add -ptest packages for all ptest-enabled packages
#                     (useful if you want to run the package test suites)
#  "tools-sdk"      - add development tools (gcc, make, pkgconfig etc.)
#  "tools-debug"    - add debugging tools (gdb, strace)
#  "eclipse-debug"  - add Eclipse remote debugging support
#  "tools-profile"  - add profiling tools (oprofile, lttng, valgrind)
#  "tools-testapps" - add useful testing tools (ts_print, aplay, arecord etc.)
#  "debug-tweaks"   - make an image suitable for development
#                     e.g. ssh root access has a blank password
# There are other application targets that can be used here too, see
# meta/classes/image.bbclass and meta/classes/core-image.bbclass for more details.
# We default to enabling the debugging tweaks.
EXTRA_IMAGE_FEATURES ?= "debug-tweaks"

#
# Parallelism Options
#
# These two options control how much parallelism BitBake should use. The first
# option determines how many tasks bitbake should run in parallel:
#
#BB_NUMBER_THREADS ?= "4"
#
# Default to setting automatically based on cpu count
#BB_NUMBER_THREADS ?= "${@oe.utils.cpu_count()}"
#
# The second option controls how many processes make should run in parallel when
# running compile tasks:
#
#PARALLEL_MAKE ?= "-j 4"
#
# Default to setting automatically based on cpu count
#PARALLEL_MAKE ?= "-j ${@oe.utils.cpu_count()}"
#
# For a quad-core machine, BB_NUMBER_THREADS = "4", PARALLEL_MAKE = "-j 4" would
# be appropriate for example.

#
# Removes sources after build to conserve diskspace
#
INHERIT += "rm_work"
RM_WORK_EXCLUDE += "qemu-helper-native"

#
# Use source mirror in China
#
# Uncomment this if you are building in China, and/or have trouble fetching sources.
#
#INHERIT += "own-mirrors"
#SOURCE_MIRROR_URL = "http://114.116.235.68/source-mirror"

#
# Use out-of-China mirror of OpenHarmony git repositories.
#
MIRRORS:prepend = "git://gitee.com/openharmony/ git://github.com/openharmony/ \n "

#
# Choose OpenHarmony version
#
# Uncomment to override the variable OPENHARMONY_VERSION set in the
# distro configuration file.
#
#OPENHARMONY_VERSION = "3.1"
```
